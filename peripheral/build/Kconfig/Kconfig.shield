## peripheral/build/Kconfig/Kconfig.shield
```kconfig
osource "c:/users/qlab/desktop/nrf/simplebleconn/central/boards/shields/*/Kconfig.shield"
osource "c:/users/qlab/desktop/nrf/simplebleconn/peripheral/boards/shields/*/Kconfig.shield"
osource "C:/ncs/v2.6.1/nrf/boards/shields/*/Kconfig.shield"
```

## peripheral/build/Kconfig/Kconfig.shield.defconfig
```kconfig
osource "c:/users/qlab/desktop/nrf/simplebleconn/central/boards/shields/*/Kconfig.defconfig"
osource "c:/users/qlab/desktop/nrf/simplebleconn/peripheral/boards/shields/*/Kconfig.defconfig"
osource "C:/ncs/v2.6.1/nrf/boards/shields/*/Kconfig.defconfig"
```

## peripheral/build/peripheral/Kconfig/Kconfig.shield
```kconfig
osource "c:/ncs/v2.6.1/zephyr/samples/bluetooth/peripheral/boards/shields/*/Kconfig.shield"
osource "C:/ncs/v2.6.1/nrf/boards/shields/*/Kconfig.shield"
```

## peripheral/build/peripheral/Kconfig/Kconfig.shield.defconfig
```kconfig
osource "c:/ncs/v2.6.1/zephyr/samples/bluetooth/peripheral/boards/shields/*/Kconfig.defconfig"
osource "C:/ncs/v2.6.1/nrf/boards/shields/*/Kconfig.defconfig"
```
